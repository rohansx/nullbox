## kernel/config/aarch64_defconfig
```kconfig
# NullBox KSPP-Hardened Kernel Configuration — aarch64
#
# Based on: Linux 6.18 LTS
# Toolchain: Clang + ThinLTO (required for CFI)
# Philosophy: Only enable what NullBox needs. Nothing else.
#
# Reference: kernel/README.md, ARCHITECTURE.md

#
# === General ===
#
CONFIG_64BIT=y
CONFIG_ARM64=y
CONFIG_ARM64_VA_BITS_48=y
CONFIG_SMP=y
CONFIG_NR_CPUS=256
CONFIG_PREEMPT=y
CONFIG_HZ_1000=y
CONFIG_NO_HZ_FULL=y
CONFIG_HIGH_RES_TIMERS=y
CONFIG_POSIX_MQUEUE=y
CONFIG_SYSVIPC=y
CONFIG_AUDIT=y
CONFIG_BLK_DEV_INITRD=y
CONFIG_CGROUPS=y
CONFIG_CGROUP_CPUACCT=y
CONFIG_CGROUP_SCHED=y
CONFIG_CGROUP_FREEZER=y
CONFIG_CGROUP_DEVICE=y
CONFIG_CGROUP_PIDS=y
CONFIG_MEMCG=y
CONFIG_BLK_CGROUP=y
CONFIG_CPUSETS=y
CONFIG_NAMESPACES=y
CONFIG_UTS_NS=y
CONFIG_IPC_NS=y
CONFIG_PID_NS=y
CONFIG_NET_NS=y
CONFIG_USER_NS=y

#
# === THE MOST IMPORTANT FLAG ===
#
# No loadable kernel modules. EVER.
# All drivers compiled in at build time.
# Eliminates: insmod, modprobe, eBPF rootkits, custom kernel modules.
# Attack surface fixed permanently at compilation.
#
# CONFIG_MODULES is not set

#
# === io_uring: DISABLED (unresolved attack surface) ===
#
# Bypasses all syscall monitoring (ARMO "Curing" rootkit PoC).
# Agent workloads are network-bound, not disk-bound.
#
# CONFIG_IO_URING is not set

#
# === Memory Protection (KSPP) ===
#
CONFIG_STRICT_KERNEL_RWX=y
CONFIG_STRICT_MODULE_RWX=y
CONFIG_RANDOMIZE_BASE=y
CONFIG_STACKPROTECTOR=y
CONFIG_STACKPROTECTOR_STRONG=y
CONFIG_VMAP_STACK=y
CONFIG_INIT_STACK_ALL_ZERO=y
CONFIG_HARDENED_USERCOPY=y
CONFIG_FORTIFY_SOURCE=y
CONFIG_INIT_ON_ALLOC_DEFAULT_ON=y
CONFIG_INIT_ON_FREE_DEFAULT_ON=y
CONFIG_SLAB_FREELIST_RANDOM=y
CONFIG_SLAB_FREELIST_HARDENED=y
CONFIG_SHUFFLE_PAGE_ALLOCATOR=y
CONFIG_RANDOM_KMALLOC_CACHES=y

#
# === ARM64 Hardware Security Features ===
#
CONFIG_ARM64_PTR_AUTH=y
CONFIG_ARM64_BTI=y
CONFIG_ARM64_MTE=y

#
# === Control Flow Integrity (requires Clang) ===
#
CONFIG_CFI_CLANG=y
CONFIG_LTO_CLANG_THIN=y

#
# === Syscall Filtering (Cage per-agent profiles) ===
#
CONFIG_SECCOMP=y
CONFIG_SECCOMP_FILTER=y

#
# === Mandatory Access Control ===
#
CONFIG_SECURITY=y
CONFIG_SECURITY_APPARMOR=y
CONFIG_SECURITY_LANDLOCK=y
CONFIG_LSM="landlock,lockdown,yama,apparmor,bpf"
CONFIG_SECURITY_YAMA=y
CONFIG_SECURITY_LOCKDOWN_LSM=y
CONFIG_SECURITY_LOCKDOWN_LSM_EARLY=y
CONFIG_LOCK_DOWN_KERNEL_FORCE_INTEGRITY=y

#
# === eBPF (Watcher audit probes) ===
#
CONFIG_BPF=y
CONFIG_BPF_SYSCALL=y
CONFIG_BPF_JIT=y
CONFIG_BPF_JIT_ALWAYS_ON=y
CONFIG_BPF_LSM=y

#
# === Virtualization (Cage microVMs via libkrun) ===
#
CONFIG_VIRTUALIZATION=y
CONFIG_KVM=y
CONFIG_VHOST=y
CONFIG_VHOST_NET=y
CONFIG_VHOST_VSOCK=y

#
# === VirtIO (guest-host communication for Cage VMs) ===
#
CONFIG_VIRTIO=y
CONFIG_VIRTIO_PCI=y
CONFIG_VIRTIO_BLK=y
CONFIG_VIRTIO_NET=y
CONFIG_VIRTIO_CONSOLE=y
CONFIG_VIRTIO_BALLOON=y
CONFIG_VIRTIO_MMIO=y
CONFIG_VIRTIO_INPUT=y

#
# === Filesystem ===
#
CONFIG_SQUASHFS=y
CONFIG_SQUASHFS_ZSTD=y
CONFIG_SQUASHFS_LZ4=y
CONFIG_OVERLAY_FS=y
CONFIG_TMPFS=y
CONFIG_TMPFS_POSIX_ACL=y
CONFIG_PROC_FS=y
CONFIG_SYSFS=y
CONFIG_DEVTMPFS=y
CONFIG_DEVTMPFS_MOUNT=y
CONFIG_EXT4_FS=y
CONFIG_VFAT_FS=y
CONFIG_NLS_CODEPAGE_437=y
CONFIG_NLS_ISO8859_1=y

#
# === Block devices ===
#
CONFIG_BLK_DEV=y
CONFIG_BLK_DEV_LOOP=y
CONFIG_BLK_DEV_RAM=y

#
# === Encryption (Warden vault) ===
#
CONFIG_DM_CRYPT=y
CONFIG_CRYPTO=y
CONFIG_CRYPTO_AES=y
CONFIG_CRYPTO_GCM=y
CONFIG_CRYPTO_SHA256=y
CONFIG_CRYPTO_SHA512=y
CONFIG_CRYPTO_USER=y
CONFIG_CRYPTO_USER_API=y
CONFIG_CRYPTO_USER_API_HASH=y
CONFIG_CRYPTO_USER_API_SKCIPHER=y
CONFIG_CRYPTO_USER_API_AEAD=y

#
# === ARM64 Hardware Crypto Acceleration ===
#
CONFIG_CRYPTO_AES_ARM64_CE=y
CONFIG_CRYPTO_SHA256_ARM64_CE=y
CONFIG_CRYPTO_SHA512_ARM64_CE=y

#
# === Networking ===
#
CONFIG_NET=y
CONFIG_INET=y
CONFIG_NETDEVICES=y
CONFIG_NET_CORE=y
CONFIG_PCI=y
CONFIG_IPV6=y
CONFIG_NETFILTER=y
CONFIG_NF_CONNTRACK=y
CONFIG_NF_TABLES=y
CONFIG_NF_TABLES_INET=y
CONFIG_NFT_CT=y
CONFIG_NFT_LOG=y
CONFIG_NFT_REJECT=y
CONFIG_NFT_MASQ=y
CONFIG_NFT_NAT=y
CONFIG_NF_NAT=y
CONFIG_IP_NF_IPTABLES=y
CONFIG_IP_NF_FILTER=y
CONFIG_IP_NF_NAT=y
CONFIG_BRIDGE=y
CONFIG_VLAN_8021Q=y
CONFIG_TUN=y
CONFIG_TAP=y
CONFIG_MACVLAN=y
CONFIG_MACVTAP=y
CONFIG_VETH=y
CONFIG_PACKET=y
CONFIG_UNIX=y

#
# === Ethernet NIC drivers (built-in for bare metal) ===
#
# Broadcom (RPi5 GENET + server NICs)
CONFIG_BCMGENET=y
CONFIG_TIGON3=y
CONFIG_BNX2=y
CONFIG_BNXT=y
# Realtek (common consumer boards)
CONFIG_R8169=y
# Mellanox/NVIDIA ConnectX
CONFIG_MLX4_EN=y
CONFIG_MLX5_CORE=y
CONFIG_MLX5_CORE_EN=y
# AMD/Pensando
CONFIG_AMD_XGBE=y
# Aquantia/Marvell (2.5G/5G/10G on newer boards)
CONFIG_ATLANTIC=y
# Generic MII/MDIO for PHY support
CONFIG_PHYLIB=y
CONFIG_MDIO_DEVICE=y
CONFIG_MDIO_BUS=y

#
# === WiFi (basic support for RPi5 + laptops/edge) ===
#
CONFIG_WIRELESS=y
CONFIG_CFG80211=y
CONFIG_MAC80211=y
CONFIG_WLAN=y
# Broadcom WiFi (RPi5 onboard)
CONFIG_BRCMFMAC=y
CONFIG_BRCMUTIL=y
# Intel WiFi
CONFIG_IWLWIFI=y
CONFIG_IWLMVM=y
# Realtek WiFi
CONFIG_RTW88=y
CONFIG_RTW89=y
# Atheros/Qualcomm
CONFIG_ATH9K=y
CONFIG_ATH10K=y
CONFIG_ATH11K=y

#
# === Storage drivers (built-in, no modules) ===
#
CONFIG_ATA=y
CONFIG_SATA_AHCI=y
CONFIG_BLK_DEV_SD=y
CONFIG_BLK_DEV_SR=y
CONFIG_SCSI=y
CONFIG_SCSI_MOD=y
CONFIG_BLK_DEV_NVME=y
CONFIG_MMC=y
CONFIG_MMC_BCM2835=y
CONFIG_MMC_SDHCI=y
CONFIG_MMC_SDHCI_IPROC=y
CONFIG_USB_STORAGE=y

#
# === USB (for RPi and general hardware) ===
#
CONFIG_USB_SUPPORT=y
CONFIG_USB=y
CONFIG_USB_XHCI_HCD=y
CONFIG_USB_EHCI_HCD=y
CONFIG_USB_OHCI_HCD=y

#
# === Serial console (primary debug interface) ===
#
CONFIG_SERIAL_AMBA_PL011=y
CONFIG_SERIAL_AMBA_PL011_CONSOLE=y

#
# === EFI boot ===
#
CONFIG_EFI=y
CONFIG_EFI_STUB=y
CONFIG_FRAMEBUFFER_CONSOLE=y
CONFIG_FB_SIMPLE=y

#
# === Device Tree (required for ARM64 SoC) ===
#
CONFIG_OF=y
CONFIG_OF_ADDRESS=y
CONFIG_OF_IRQ=y

#
# === ARM64 Interrupt Controller ===
#
CONFIG_ARM_GIC_V3=y

#
# === ARM64 Timer ===
#
CONFIG_ARM_ARCH_TIMER=y

#
# === ARM64 PSCI Firmware Interface ===
#
CONFIG_ARM_PSCI_FW=y

#
# === RPi5 SoC (BCM2712) ===
#
CONFIG_ARCH_BCM2835=y
CONFIG_BCM2835_MBOX=y
CONFIG_BCM2835_WDT=y
CONFIG_RASPBERRYPI_FIRMWARE=y
CONFIG_RASPBERRYPI_POWER=y
CONFIG_PCIE_BRCMSTB=y
CONFIG_PINCTRL=y
CONFIG_PINCTRL_BCM2835=y
CONFIG_BCM2835_THERMAL=y

#
# === Power management ===
#
CONFIG_SUSPEND=y
CONFIG_CPU_FREQ=y
CONFIG_CPU_FREQ_DEFAULT_GOV_SCHEDUTIL=y
CONFIG_CPUFREQ_DT=y
CONFIG_ARM_SCMI_CPUFREQ=y

#
# === Misc required ===
#
CONFIG_PRINTK=y
CONFIG_EARLY_PRINTK=y
CONFIG_TTY=y
CONFIG_VT=y
CONFIG_VT_CONSOLE=y
CONFIG_BINFMT_ELF=y
CONFIG_BINFMT_SCRIPT=y
CONFIG_INOTIFY_USER=y
CONFIG_SIGNALFD=y
CONFIG_TIMERFD=y
CONFIG_EVENTFD=y
CONFIG_EPOLL=y
CONFIG_FUTEX=y
CONFIG_MULTIUSER=y
CONFIG_NET_SCHED=y

#
# === Hardening: disable dangerous features ===
#
# CONFIG_KEXEC is not set
# CONFIG_HIBERNATION is not set
# CONFIG_COMPAT_BRK is not set
# CONFIG_DEVKMEM is not set
# CONFIG_BINFMT_MISC is not set
# CONFIG_USELIB is not set
# CONFIG_KPROBES is not set
```

## kernel/config/x86_64_defconfig
```kconfig
# NullBox KSPP-Hardened Kernel Configuration — x86_64
#
# Based on: Linux 6.18 LTS
# Toolchain: Clang + ThinLTO (required for CFI)
# Philosophy: Only enable what NullBox needs. Nothing else.
#
# Reference: kernel/README.md, ARCHITECTURE.md

#
# === General ===
#
CONFIG_64BIT=y
CONFIG_SMP=y
CONFIG_NR_CPUS=256
CONFIG_PREEMPT=y
CONFIG_HZ_1000=y
CONFIG_NO_HZ_FULL=y
CONFIG_HIGH_RES_TIMERS=y
CONFIG_POSIX_MQUEUE=y
CONFIG_SYSVIPC=y
CONFIG_AUDIT=y
CONFIG_BLK_DEV_INITRD=y
CONFIG_CGROUPS=y
CONFIG_CGROUP_CPUACCT=y
CONFIG_CGROUP_SCHED=y
CONFIG_CGROUP_FREEZER=y
CONFIG_CGROUP_DEVICE=y
CONFIG_CGROUP_PIDS=y
CONFIG_MEMCG=y
CONFIG_BLK_CGROUP=y
CONFIG_CPUSETS=y
CONFIG_NAMESPACES=y
CONFIG_UTS_NS=y
CONFIG_IPC_NS=y
CONFIG_PID_NS=y
CONFIG_NET_NS=y
CONFIG_USER_NS=y

#
# === THE MOST IMPORTANT FLAG ===
#
# No loadable kernel modules. EVER.
# All drivers compiled in at build time.
# Eliminates: insmod, modprobe, eBPF rootkits, custom kernel modules.
# Attack surface fixed permanently at compilation.
#
# CONFIG_MODULES is not set

#
# === io_uring: DISABLED (unresolved attack surface) ===
#
# Bypasses all syscall monitoring (ARMO "Curing" rootkit PoC).
# Agent workloads are network-bound, not disk-bound.
#
# CONFIG_IO_URING is not set

#
# === Memory Protection (KSPP) ===
#
CONFIG_STRICT_KERNEL_RWX=y
CONFIG_STRICT_MODULE_RWX=y
CONFIG_RANDOMIZE_BASE=y
CONFIG_RANDOMIZE_MEMORY=y
CONFIG_STACKPROTECTOR=y
CONFIG_STACKPROTECTOR_STRONG=y
CONFIG_VMAP_STACK=y
CONFIG_INIT_STACK_ALL_ZERO=y
CONFIG_HARDENED_USERCOPY=y
CONFIG_FORTIFY_SOURCE=y
CONFIG_INIT_ON_ALLOC_DEFAULT_ON=y
CONFIG_INIT_ON_FREE_DEFAULT_ON=y
CONFIG_PAGE_TABLE_ISOLATION=y
CONFIG_SLAB_FREELIST_RANDOM=y
CONFIG_SLAB_FREELIST_HARDENED=y
CONFIG_SHUFFLE_PAGE_ALLOCATOR=y
CONFIG_RANDOM_KMALLOC_CACHES=y

#
# === Control Flow Integrity (requires Clang) ===
#
CONFIG_CFI_CLANG=y
CONFIG_LTO_CLANG_THIN=y

#
# === Syscall Filtering (Cage per-agent profiles) ===
#
CONFIG_SECCOMP=y
CONFIG_SECCOMP_FILTER=y

#
# === Mandatory Access Control ===
#
CONFIG_SECURITY=y
CONFIG_SECURITY_APPARMOR=y
CONFIG_SECURITY_LANDLOCK=y
CONFIG_LSM="landlock,lockdown,yama,apparmor,bpf"
CONFIG_SECURITY_YAMA=y
CONFIG_SECURITY_LOCKDOWN_LSM=y
CONFIG_SECURITY_LOCKDOWN_LSM_EARLY=y
CONFIG_LOCK_DOWN_KERNEL_FORCE_INTEGRITY=y

#
# === eBPF (Watcher audit probes) ===
#
CONFIG_BPF=y
CONFIG_BPF_SYSCALL=y
CONFIG_BPF_JIT=y
CONFIG_BPF_JIT_ALWAYS_ON=y
CONFIG_BPF_LSM=y

#
# === Virtualization (Cage microVMs via libkrun) ===
#
CONFIG_VIRTUALIZATION=y
CONFIG_KVM=y
CONFIG_KVM_INTEL=y
CONFIG_KVM_AMD=y
CONFIG_VHOST=y
CONFIG_VHOST_NET=y
CONFIG_VHOST_VSOCK=y

#
# === VirtIO (guest-host communication for Cage VMs) ===
#
CONFIG_VIRTIO=y
CONFIG_VIRTIO_PCI=y
CONFIG_VIRTIO_BLK=y
CONFIG_VIRTIO_NET=y
CONFIG_VIRTIO_CONSOLE=y
CONFIG_VIRTIO_BALLOON=y
CONFIG_VIRTIO_MMIO=y
CONFIG_VIRTIO_INPUT=y

#
# === Filesystem ===
#
CONFIG_SQUASHFS=y
CONFIG_SQUASHFS_ZSTD=y
CONFIG_SQUASHFS_LZ4=y
CONFIG_OVERLAY_FS=y
CONFIG_TMPFS=y
CONFIG_TMPFS_POSIX_ACL=y
CONFIG_PROC_FS=y
CONFIG_SYSFS=y
CONFIG_DEVTMPFS=y
CONFIG_DEVTMPFS_MOUNT=y
CONFIG_EXT4_FS=y
CONFIG_VFAT_FS=y
CONFIG_NLS_CODEPAGE_437=y
CONFIG_NLS_ISO8859_1=y

#
# === Block devices ===
#
CONFIG_BLK_DEV=y
CONFIG_BLK_DEV_LOOP=y
CONFIG_BLK_DEV_RAM=y

#
# === Encryption (Warden vault) ===
#
CONFIG_DM_CRYPT=y
CONFIG_CRYPTO=y
CONFIG_CRYPTO_AES=y
CONFIG_CRYPTO_GCM=y
CONFIG_CRYPTO_SHA256=y
CONFIG_CRYPTO_SHA512=y
CONFIG_CRYPTO_USER=y
CONFIG_CRYPTO_USER_API=y
CONFIG_CRYPTO_USER_API_HASH=y
CONFIG_CRYPTO_USER_API_SKCIPHER=y
CONFIG_CRYPTO_USER_API_AEAD=y

#
# === Networking ===
#
CONFIG_NET=y
CONFIG_INET=y
CONFIG_NETDEVICES=y
CONFIG_NET_CORE=y
CONFIG_PCI=y
CONFIG_IPV6=y
CONFIG_NETFILTER=y
CONFIG_NF_CONNTRACK=y
CONFIG_NF_TABLES=y
CONFIG_NF_TABLES_INET=y
CONFIG_NFT_CT=y
CONFIG_NFT_LOG=y
CONFIG_NFT_REJECT=y
CONFIG_NFT_MASQ=y
CONFIG_NFT_NAT=y
CONFIG_NF_NAT=y
CONFIG_IP_NF_IPTABLES=y
CONFIG_IP_NF_FILTER=y
CONFIG_IP_NF_NAT=y
CONFIG_BRIDGE=y
CONFIG_VLAN_8021Q=y
CONFIG_TUN=y
CONFIG_TAP=y
CONFIG_MACVLAN=y
CONFIG_MACVTAP=y
CONFIG_VETH=y
CONFIG_PACKET=y
CONFIG_UNIX=y

#
# === Storage drivers (built-in, no modules) ===
#
CONFIG_ATA=y
CONFIG_SATA_AHCI=y
CONFIG_ATA_PIIX=y
CONFIG_BLK_DEV_SD=y
CONFIG_BLK_DEV_SR=y
CONFIG_SCSI=y
CONFIG_SCSI_MOD=y
CONFIG_BLK_DEV_NVME=y
CONFIG_MMC=y
CONFIG_USB_STORAGE=y

#
# === USB (for RPi and general hardware) ===
#
CONFIG_USB_SUPPORT=y
CONFIG_USB=y
CONFIG_USB_XHCI_HCD=y
CONFIG_USB_EHCI_HCD=y
CONFIG_USB_OHCI_HCD=y

#
# === Serial console (primary debug interface) ===
#
CONFIG_SERIAL_8250=y
CONFIG_SERIAL_8250_CONSOLE=y
CONFIG_SERIAL_8250_PCI=y

#
# === EFI boot ===
#
CONFIG_EFI=y
CONFIG_EFI_STUB=y
CONFIG_EFI_MIXED=y
CONFIG_FB_EFI=y
CONFIG_FRAMEBUFFER_CONSOLE=y

#
# === Power management ===
#
CONFIG_SUSPEND=y
CONFIG_HIBERNATION=y
CONFIG_CPU_FREQ=y
CONFIG_CPU_FREQ_DEFAULT_GOV_SCHEDUTIL=y
CONFIG_ACPI=y
CONFIG_ACPI_CPPC_CPUFREQ=y

#
# === Confidential Computing (future, enabled now) ===
#
CONFIG_AMD_MEM_ENCRYPT=y
CONFIG_INTEL_TDX_GUEST=y

#
# === Misc required ===
#
CONFIG_PRINTK=y
CONFIG_EARLY_PRINTK=y
CONFIG_TTY=y
CONFIG_VT=y
CONFIG_VT_CONSOLE=y
CONFIG_BINFMT_ELF=y
CONFIG_BINFMT_SCRIPT=y
CONFIG_INOTIFY_USER=y
CONFIG_SIGNALFD=y
CONFIG_TIMERFD=y
CONFIG_EVENTFD=y
CONFIG_EPOLL=y
CONFIG_FUTEX=y
CONFIG_MULTIUSER=y
CONFIG_NET_SCHED=y

#
# === Hardening: disable dangerous features ===
#
# CONFIG_KEXEC is not set
# CONFIG_HIBERNATION is not set
# CONFIG_COMPAT_BRK is not set
# CONFIG_DEVKMEM is not set
# CONFIG_BINFMT_MISC is not set
# CONFIG_USELIB is not set
# CONFIG_MODIFY_LDT_SYSCALL is not set
# CONFIG_OABI_COMPAT is not set
# CONFIG_KPROBES is not set
```
